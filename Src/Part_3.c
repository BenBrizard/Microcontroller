#include "Part_3.h"

// one of our special feature is to display the face of our teacher on the LCD with the mention "Thank you" at the bottom
// here is the bitmap of his face :
const uint8_t photo_JP[]={1,1,0,0,1,1,0,0,0,0,0,0,0,0,0,0,0,0,0,0,0,0,0,0,0,0,0,1,1,1,1,1,1,1,1,1,1,1,1,1,1,1,1,0,0,0,0,0,0,0,0,0,0,0,0,0,0,0,0,0,0,1,1,1,0,
1,1,0,0,0,0,0,0,0,1,0,0,0,1,0,0,0,0,0,0,0,0,1,1,1,1,1,1,1,1,0,0,1,0,0,0,0,0,0,1,1,1,1,1,1,0,0,0,0,0,0,0,0,0,0,0,0,0,0,0,0,1,1,1,0,
1,1,0,0,0,0,0,0,1,0,0,0,0,1,0,0,0,0,0,0,1,1,1,1,1,1,1,1,1,0,0,1,1,0,0,0,0,0,1,0,0,1,1,1,1,1,1,1,1,0,0,0,0,0,0,0,0,0,0,0,0,0,0,0,0,
1,1,0,0,0,0,0,0,0,0,0,0,0,0,1,0,0,1,1,1,1,1,1,1,1,1,1,1,1,1,1,1,0,1,1,1,1,1,1,1,1,1,1,1,1,1,1,1,1,1,1,0,0,0,0,0,0,0,0,0,0,0,0,0,0,
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0,0,0,0,0,0,0,0,0,0,1,1,1,1,1,1,1,1,1,1,1,1,1,1,1,1,1,1,1,1,1,1,1,1,0,0,0,0,0,0,0,1,1,1,1,1,1,0,0,0,0,0,0,0,0,0,0,0,0,1,1,1,0,0,0

};
//photo displayed in the Zelda special mode
const uint8_t photo_Zelda[]={
0,0,0,0,0,0,0,0,0,0,1,1,1,1,0,0,1,1,1,1,0,0,0,0,0,0,0,0,0,0,
0,0,0,0,0,0,0,1,1,1,1,0,0,0,1,1,0,0,0,1,1,1,0,0,0,0,0,0,0,0,
0,0,0,0,1,1,1,1,1,0,0,1,1,0,1,1,0,1,1,0,0,1,1,1,1,1,0,0,0,0,
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0,0,0,0,0,0,0,0,0,0,0,0,1,1,0,0,1,1,0,0,0,0,0,0,0,0,0,0,0,0

};
//photo displayed in the Mario special mode
const uint8_t photo_Mario[]={
0,0,0,1,1,1,1,1,1,1,0,0,0,0,0,
0,0,1,0,0,0,0,0,0,0,1,1,1,1,0,
0,0,1,0,0,0,1,1,1,1,1,1,1,1,0,
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1,1,1,1,1,0,0,0,0,0,1,1,1,1,1
};
const uint8_t largeur_JP=65;
const uint8_t hauteur_JP=81;

const uint8_t largeur_Zelda=30;
const uint8_t hauteur_Zelda=35;

const uint8_t largeur_Mario=15;
const uint8_t hauteur_Mario=19;

// Displays the mode choices
 void showModeMenu(void){
        
		LCD_FillScreen(BLACK);
	  LCD_SetCursor(0,5);
		LCD_SetTextSize(2);
		LCD_Printf("Selectionner le mode");
		LCD_SetCursor(35,25);
		LCD_Printf("de l'intrument");
		LCD_DrawRect(0, 50, 240 , 90, WHITE);
		LCD_DrawRect(0, 140, 240 , 90, WHITE);
		LCD_DrawRect(0, 230, 240 , 90, WHITE);
		LCD_SetTextSize(4);
		LCD_SetCursor( 50,80);
		LCD_Printf("Mode 0");
		LCD_SetCursor(50,170);
		LCD_Printf("Mode 1");
		LCD_SetCursor(50,260);
		LCD_Printf("Mode 2");
	}
 
	//displays the instruments choices
 void showInstrumentMenu(void){
        
      LCD_FillScreen(BLACK);
			LCD_SetCursor(45,5);
      LCD_SetTextSize(2);
      LCD_Printf("Selectionner");
      LCD_SetCursor(45,25);
      LCD_Printf("l'instrument");
      LCD_DrawRect(0, 50, 240 , 67, WHITE);
      LCD_DrawRect(0, 117, 240 , 67, WHITE);
      LCD_DrawRect(0, 184, 240 , 67, WHITE);
      LCD_DrawRect(0, 251, 240 , 67, WHITE);
      LCD_SetTextSize(4);
      LCD_SetCursor(60,75);
      LCD_Printf("Piano");
      LCD_SetCursor(60,142);
      LCD_Printf("Flute");
			LCD_SetCursor( 50,209);
      LCD_Printf("Violon");
			LCD_SetCursor(30,276);
      LCD_Printf("Diapason");
	}
 
	//displays the musical scale choices
  void showGammeMenu(void){
        
      LCD_FillScreen(BLACK);
			LCD_SetCursor(45,5);
      LCD_SetTextSize(2);
      LCD_Printf("Selectionner");
      LCD_SetCursor(65,25);
       LCD_Printf("la gamme");
      LCD_DrawRect(0, 50, 240 , 90, WHITE);
      LCD_DrawRect(0, 140, 240 , 90, WHITE);
      LCD_DrawRect(0, 230, 240 , 90, WHITE);
      LCD_SetTextSize(4);
      LCD_SetCursor( 10,80);
      LCD_Printf("Chromatic");
      LCD_SetCursor(0,170);
      LCD_Printf("Pentatonic");
      LCD_SetCursor(25,260);
      LCD_Printf("Diatonic");
	}
	
	// final display. For example if the user choosed the flute, here appears a flute and the name of the musical scale chosen
void showFenetrePrincipal(setting* setting_actuel){
	
	
	LCD_SetTextSize(4);
	LCD_FillScreen(BLACK);
	LCD_SetCursor(45,5);
	// On divise par deux pour que la valeure key pressed (1,2,4)
	// corresponde au nombre reel de notre mode (le 0 est sketch on fait 1/2 et ca cast un int a 0)
	LCD_Printf("Mode %d ",setting_actuel->Mode);
	
switch(setting_actuel->Instrument){
	case(PIANO):
		LCD_SetCursor(55,40);
		LCD_Printf("Piano");
		//LCD_DrawRect();
	  LCD_FillRect(20,175,196,120,WHITE);
		LCD_DrawRect(20,175,22,120,BLACK);
		LCD_DrawRect(42,175,22,120,BLACK);
		LCD_DrawRect(64,175,22,120,BLACK);
		LCD_DrawRect(86,175,22,120,BLACK);
		LCD_DrawRect(108,175,22,120,BLACK);
		LCD_DrawRect(130,175,22,120,BLACK);
		LCD_DrawRect(152,175,22,120,BLACK);
		LCD_DrawRect(174,175,22,120,BLACK);
		LCD_DrawRect(20,175,196,120,BLACK);
		LCD_FillRect(34,175,14,65,BLACK);
		LCD_FillRect(78,175,14,65,BLACK);
		LCD_FillRect(100,175,14,65,BLACK);
		LCD_FillRect(122,175,14,65,BLACK);
		LCD_FillRect(166,175,14,65,BLACK);
		LCD_FillRect(188,175,14,65,BLACK);
		
	break;
		
	case(FLUTE):
		LCD_SetCursor(55,40);
		LCD_Printf("Flute");
		LCD_FillRoundRect(30,200,175,35,20,WHITE);
		LCD_FillRect(50,200,165,35,WHITE);
		LCD_FillRect(55,210,20,15,BLACK);
		LCD_FillCircle(100,216,5,BLACK);
		LCD_FillCircle(130,216,5,BLACK);
		LCD_FillCircle(160,216,5,BLACK);
		LCD_FillCircle(190,216,5,BLACK);
		
	break;
		
	case(VIOLON):
		LCD_SetCursor(45,40);
		LCD_Printf("Violon");
		LCD_FillRect(35,215,95,20,WHITE);
		LCD_FillRect(110,200,85,50,WHITE);
		LCD_FillCircle(152,167,45,BLACK); 
		LCD_FillCircle(152,280,45,BLACK);
		LCD_FillRect(40,200,5,15,WHITE);
		LCD_FillRect(40,235,5,15,WHITE);
		LCD_FillRect(52,200,5,15,WHITE);
		LCD_FillRect(52,235,5,15,WHITE);
		LCD_FillRect(180,212,8,25,BLACK);
		LCD_DrawFastHLine(40,220,140,BLACK);
		LCD_DrawFastHLine(40,223,140,BLACK);
		LCD_DrawFastHLine(40,226,140,BLACK);
		LCD_DrawFastHLine(40,229,140,BLACK);
	break;
		
	case(DIAPASON):
		LCD_SetCursor(25,40);
		LCD_Printf("Diapason");
		LCD_FillRect(20,175,196,120,BLACK);
		LCD_FillRoundRect(30,200,100,15,10,WHITE);
		LCD_FillRoundRect(30,255,100,15,10,WHITE);
		LCD_FillRect(120,200,15,70,WHITE);
		LCD_FillRect(120,225,80,15,WHITE);
		
	break;
}
switch(setting_actuel->Mode){
case(MODE0):
			LCD_SetCursor(10,75);
			LCD_Printf("Chromatic");
			LCD_DrawRect(0, 110, 240 , 205, WHITE);
	break;
		
	case(MODE1):
			LCD_DrawRect(0, 80, 240 , 240, WHITE);
	break;
		
	case(MODE2):
		LCD_DrawRect(0, 110, 240 , 205, WHITE);
	
		switch(setting_actuel->Gamme){
			case(PENTATONIC):
						LCD_SetCursor(0,75);
						LCD_Printf("Pentatonic");
			break;
			
			case(DIATONIC):
						LCD_SetCursor(25,75);
						LCD_Printf("Diatonic");
			break;
						
			case(CHROMATIC):
						LCD_SetCursor(10,75);
						LCD_Printf("Chromatic");
			break;
		}
	
	break;
		
}


}



// (x,y): position ou on veut afficher la note
// displays the note
void showNoteMode0(const struct Positions* position)
{
		LCD_FillRect(position->x, position->y, 218, 50, BLACK);
		LCD_SetCursor(position->x,position->y);
		//LCD_Printf("%c ",notesTab_chromatique[(int)note[0]]);
		if((int)note[0]>=0)
		{
			for(int i =0;i<3;i++)
			{
				LCD_Printf("%c",tab_BEN[(int)note[0]*3+i]);
			
			}
		}
		LCD_Printf("%.2f",mean[0]);
};

// (x,y): position ou on veut afficher la note
void showNoteMode1(const struct Positions* position)
{
		LCD_FillRect(position->x, position->y, 185, 50, BLACK);
		LCD_SetCursor(position->x,position->y);
		LCD_Printf("%.2f ",signal_freq);
};

// (x,y): position ou on veut afficher la note
// note: struct de note avec un dieze ou non
void showNoteMode2( const struct Positions* position)
{
		LCD_FillRect(position->x, position->y, 185, 50, BLACK);
		LCD_SetCursor(position->x,position->y);

	if((int)note[0]>=0)
	{
		for(int i =0;i<3;i++)
		{
			LCD_Printf("%c",tab_BEN[(int)note[0]*3+i]);
			
			
		}
	}
};

void selectRow (int r) {
if (r==1) HAL_GPIO_WritePin(R1_GPIO_Port, R1_Pin, GPIO_PIN_RESET);
else HAL_GPIO_WritePin(R1_GPIO_Port, R1_Pin, GPIO_PIN_SET);
if (r==2) HAL_GPIO_WritePin(R2_GPIO_Port, R2_Pin, GPIO_PIN_RESET);
else HAL_GPIO_WritePin(R2_GPIO_Port, R2_Pin, GPIO_PIN_SET);

}


int readCol() {
	int result = 0;
	if (HAL_GPIO_ReadPin(C1_GPIO_Port, C1_Pin) == GPIO_PIN_RESET) result += 1;
	if (HAL_GPIO_ReadPin(C2_GPIO_Port, C2_Pin) == GPIO_PIN_RESET) result += 2;
	if (HAL_GPIO_ReadPin(C3_GPIO_Port, C3_Pin) == GPIO_PIN_RESET) result += 4;
	if (HAL_GPIO_ReadPin(C4_GPIO_Port, C4_Pin) == GPIO_PIN_RESET) result += 8;
	return result;
}

int keyPressed(void){
	int rowPos = 1; // on utilise seulement la premiere rangИe, car on a besoins de seulement 4 options
	for(rowPos=1;rowPos<3;rowPos++){
		selectRow(rowPos); HAL_Delay(10);
		int rowValue=readCol();
		if (rowValue != 0) 
		{ // a key is pressed
			int result = 4*(rowPos-1);
			while (!(rowValue & 1)) 
			{ // test if bit #0 is false
				result++;
				rowValue>>=1;
			}
			while (readCol() != 0); // key no more pressed
			return result;
		}
	}
	return (-1);
}

// front end function. It is the master who call the other subfunction.
// This function wait for the user to press buttons and displays the next corresponding menu

void DerroulementMenu(){
	
	showInstrumentMenu();
	while((setting1.Instrument = keyPressed())<0);
	showModeMenu();
	while((setting1.Mode = keyPressed())<0);
	if(setting1.Mode==3){
		
		setting1.Instrument=0;
		setting1.Mode = 0;
		DerroulementMenu();
		return;
		
		}
		else if(setting1.Mode==MODE2){
			showGammeMenu();
			while((setting1.Gamme = keyPressed())<0);
			if(setting1.Gamme==3){
					setting1.Instrument=0;
					setting1.Mode=0;
					setting1.Gamme=0;
					DerroulementMenu();
					return;
			}
			showFenetrePrincipal(&setting1);
			
		}
		else if(setting1.Mode==MODEZELDA){
			setting1.Instrument = 0;
			setting1.Gamme = 0;
			
			LCD_FillScreen(BLACK);
			LCD_DrawPicture(photo_Zelda,largeur_Zelda,hauteur_Zelda,30,20,6);
		}
		else if(setting1.Mode==MODEMARIO){
			setting1.Instrument = 0;
			setting1.Gamme = 0;
			
			LCD_FillScreen(BLACK);
			LCD_DrawPicture(photo_Mario,largeur_Mario,hauteur_Mario,20,10,12);
		}
		else if(setting1.Mode==MODEJP){
			setting1.Instrument = 0;
			setting1.Gamme = 0;
			
			LCD_FillScreen(BLACK);
			LCD_DrawPicture(photo_JP,largeur_JP,hauteur_JP,20,0,3);
			LCD_SetTextSize(4);
			LCD_SetCursor(50,244);
			LCD_Printf("Merci!");
		}
		else
		{
			showFenetrePrincipal(&setting1);
		}
		
			
}

void LCD_DrawPicture(const uint8_t* picture_chosen, uint16_t largeur, uint16_t hauteur, int16_t l_offset, int16_t h_offset, uint8_t resizing){
	static uint8_t iterateur_ligne = 0;
	static uint8_t iterateur_colonne = 0;
	for (uint16_t i=0; i<(largeur*hauteur); i++){
			iterateur_colonne = resizing*(i%largeur);
			for(uint8_t j=0; j<resizing; j++){
				if(picture_chosen[i]){ // On fait des cases de 2 pixels de large
					for(uint8_t m=0; m<resizing; m++){
					LCD_DrawPixel(iterateur_colonne+l_offset+m,iterateur_ligne+h_offset+j, WHITE);
					}
				}
				
			}
			if(i%largeur==0 && i>0){
					iterateur_ligne+=resizing;
				}
		}
}

